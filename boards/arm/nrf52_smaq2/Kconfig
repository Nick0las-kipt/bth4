## boards/arm/nrf52_smaq2/Kconfig.board
```kconfig
config  BOARD_NRF52_SMAQ2
	bool "nRF52 SMAQ2"
	select GPIO
	depends on SOC_NRF52832_QFAA
```

## boards/arm/nrf52_smaq2/Kconfig.defconfig
```kconfig
if BOARD_NRF52_SMAQ2

config BOARD
	default "nrf52_smaq2"

config SPI
	default y

config I2C
	default y

if SPI

config SPI_2
	default y

config SOC_NRF52832_ALLOW_SPIM_DESPITE_PAN_58
	default y

config SPI_ASYNC
	default  y

endif # SPI

config I2C
	default n

if I2C

#uncomment if HW i2c needed
#config I2C_0
#	default y

#config I2C_1
#	default y

endif # I2C

config BT_CTLR
	default BT

endif # BOARD_NRF52_SMAQ2
```

## boards/arm/nrf52_smaq2/nrf52_smaq2_defconfig
```kconfig
# SPDX-License-Identifier: Apache-2.0

#CONFIG_ARM=y
#CONFIG_SOC_FAMILY_NRF=y
CONFIG_SOC_SERIES_NRF52X=y
CONFIG_SOC_NRF52832_QFAA=y
CONFIG_BOARD_NRF52_SMAQ2=y

# Enable MPU
CONFIG_ARM_MPU=y

# enable GPIO
CONFIG_GPIO=y
CONFIG_NFCT_PINS_AS_GPIOS=y

# enable uart driver
CONFIG_SERIAL=y
#CONFIG_UART_0_NRF_UART=y
CONFIG_UART_INTERRUPT_DRIVEN=y

# enable console
CONFIG_CONSOLE=y
CONFIG_UART_CONSOLE=y
```

## dts/bindings/sensor/vbat.yaml
```yaml
title: Battery Voltage sensor

description: ADC based battery voltage sensor. Result = (counts*multiplyer) >> shift in mV

compatible: "adc-vbat"

properties:
        adcs:
          type: phandle-array
          required: true
        gain_nom:
          type: int
          required: true             
        gain_denom:
          type: int
          required: false
          default: 0
        channel:
          type: int
          required: true             
        multiplyer:
          type: int
          required: true
        shift:
          type: int
          required: true
        period:
          type: int
          required: false
          default: 10000          
        label:
          type: string
          required: false
          description: Human readable string describing the device (used by Zephyr for API name)
```

## dts/bindings/sensor/vishay,veml3328.yaml
```yaml
title: Vishay light and color sensor VEML3328

description: |
    This binding gives a base representation of the VEML3328
    light and color sensor

compatible: "vishay,veml3328"

include: i2c-device.yaml

properties:
    lux_mul:
      type: int
      required: false
      default: 30
```
