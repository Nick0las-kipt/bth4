#include "fonts.h"
#include "lpm013m126.h"
#include <string.h>

#if (USE_LARGER_FONT)
#define SYM_BYTES 24
const uint8_t ascii_tab_larger[107][SYM_BYTES] __attribute((section(".text"))) = {
{  0x00, 0x00, 0x00, 0x00, 0x00, 0x00, 0x00, 0x00, 0x00, 0x00, 0x00, 0x00, 0x00, 0x00, 0x00, 0x00, 0x00, 0x00, 0x00, 0x00, 0x00, 0x00, 0x00, 0x00,  },
{  0x00, 0x00, 0x06, 0x60, 0x00, 0x0f, 0xf0, 0x00, 0x0f, 0xf0, 0x00, 0x0f, 0x60, 0x00, 0x06, 0x60, 0x00, 0x00, 0x00, 0x00, 0x06, 0x60, 0x00, 0x00,  },
{  0x00, 0x00, 0x00, 0x00, 0x80, 0x19, 0x98, 0x81, 0x19, 0x98, 0x01, 0x00, 0x00, 0x00, 0x00, 0x00, 0x00, 0x00, 0x00, 0x00, 0x00, 0x00, 0x00, 0x00,  },
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{  0x00, 0xf0, 0x07, 0x7f, 0x00, 0x06, 0x66, 0x60, 0x06, 0xe6, 0x60, 0x0e, 0xe6, 0x60, 0x0e, 0x66, 0x60, 0x06, 0x60, 0xf0, 0x07, 0x7f, 0x00, 0x00,  },
};
#endif
// ascii table, starting with character blank (32)
// size is 8x14
const uint8_t ascii_tab[107][CHAR_H] __attribute((section(".text"))) = {
{ 0x00, 0x00, 0x00, 0x00, 0x00, 0x00, 0x00, 0x00, 0x00, 0x00, 0x00, 0x00, 0x00, 0x00}, // space (32)
{ 0x00, 0x00, 0x00, 0x18, 0x3c, 0x3c, 0x3c, 0x18, 0x18, 0x00, 0x18, 0x18, 0x00, 0x00}, //!
{ 0x00, 0x66, 0x66, 0x66, 0x24, 0x00, 0x00, 0x00, 0x00, 0x00, 0x00, 0x00, 0x00, 0x00}, //"
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{ 0x00, 0x10, 0x1c, 0x96, 0xd2, 0x76, 0x3c, 0x3c, 0x76, 0xd2, 0x96, 0x1c, 0x10, 0x00}, //NON-ASCII: 0x82 \202 BT
//{ 0x00, 0x00, 0x1c, 0x22, 0x49, 0x41, 0x22, 0x12, 0x0a, 0x12, 0x0a, 0x12, 0x0c, 0x00}, //NON-ASCII: 0x83 \203 BT key
{ 0x00, 0x38, 0x6C, 0xC6, 0xC6, 0x7C, 0x10, 0x10, 0x50, 0x70, 0x30, 0x70, 0x50, 0x00}, //NON-ASCII: 0x83 \203 BT key
{ 0x00, 0x08, 0x1c, 0x3e, 0x2a, 0x08, 0x08, 0x08, 0x08, 0x2a, 0x3e, 0x1c, 0x80, 0x00}, //NON-ASCII: 0x84 \204 BT link
{ 0xF0, 0xF0, 0xF0, 0xF0, 0xF0, 0xF0, 0xF0, 0xF0, 0xF0, 0xF0, 0xF0, 0xF0, 0xF0, 0xF0}, //NON-ASCII: 0x85 \205 Split
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{ 0x00, 0x00, 0xfc, 0xfc, 0x0c, 0x6c, 0x6e, 0x6e, 0x6c, 0x0c, 0xfc, 0xfc, 0x00, 0x00}, //NON-ASCII: 0x8a \212 Batt right 1

};

#if (USE_LARGER_FONT)
static inline void _char_to_fb_4bit_pl_larger(uint8_t * ptr, char c, int startl, int endl, uint32_t fc, uint32_t bc, uint32_t line_delta)
{
    int h = startl;
    if (c < 32) c = 32;
    do {
        uint32_t nbyte = (h + (h << 1)) << 2;
        uint32_t nbit = nbyte & 7;
        nbyte >>= 3;
        unsigned int ch = ascii_tab_larger[c - 32][nbyte];
        int mask = 1 << nbit;

        for (int i = 0; i < ((LCHAR_W)/2); ++i){
            uint8_t byte = (ch & mask) ? fc : bc;
            mask <<= 1;
            byte <<= 4;
            byte |= (ch & mask) ? fc : bc;
            mask <<= 1;
            *ptr = byte;
            ++ptr;
            nbit += 2;
            if (nbit >= 8){
                nbit = 0;
                ++nbyte;
                ch = ascii_tab_larger[c - 32][nbyte];
                mask = 1;                
            }
        }
        ++h;
        ptr += (line_delta - ((LCHAR_W)/2));
    }while (h < endl);
}

void char_to_fb_4bit_pl_larger(uint8_t * ptr, char c, int startl, int endl, uint32_t fc, uint32_t bc, uint32_t line_delta){
    _char_to_fb_4bit_pl_larger(ptr, c, startl, endl, fc, bc, line_delta);
}

static inline void _put_str_col_extbuf_larger(uint8_t * buffer, uint8_t x, uint8_t line, const char *str, const uint8_t * colstr, uint8_t length){
    char end = 0;
    for (int i=0; i < length; ++i){
        uint32_t fc = colstr[i] & 0xf;
        uint32_t bc = colstr[i] >> 4;
        if (0 == str[i]) end = ' ';
        _char_to_fb_4bit_pl_larger(buffer + (x >> 1) + i * (LCHAR_W/2), end ? end : str[i], line, line, fc, bc, 0);
    }
}

void put_str_col_extbuf_larger(uint8_t * buffer, uint8_t x, uint8_t line, const char *str, const uint8_t * colstr, uint8_t length){
    _put_str_col_extbuf_larger(buffer, x, line, str, colstr, length);
}

void print_str_col_extbuf_larger(uint8_t * buffer, uint8_t x, uint8_t y, const char *str, const uint8_t * colstr, uint8_t length){
    for (int l = 0; l < LCHAR_H; ++l){
        _put_str_col_extbuf_larger(buffer, x, l, str, colstr, length);
        lcd_spi_xfer_line(&buffer[0], l+y, 4);
    }
}
#endif

static inline void _char_to_fb_4bit_pl(uint8_t * ptr, char c, int startl, int endl, uint32_t fc, uint32_t bc, uint32_t line_delta)
{
    int h = startl;
    if (c < 32) c = 32;
    do {
        unsigned int ch = ascii_tab[c - 32][h];
        int mask = 1 << (CHAR_W - 1);
        while(mask){
            uint8_t byte = (ch & mask) ? fc : bc;
            mask >>= 1;
            byte <<= 4;
            byte |= (ch & mask) ? fc : bc;
            mask >>= 1;
            *ptr = byte;
            ++ptr;
        }
        ++h;
        ptr += (line_delta - ((CHAR_W)/2));
    }while (h < endl);
}

void char_to_fb_4bit_pl(uint8_t * ptr, char c, int startl, int endl, uint32_t fc, uint32_t bc, uint32_t line_delta){
    _char_to_fb_4bit_pl(ptr, c, startl, endl, fc, bc, line_delta);
}

void arr_to_fb_4bit_pl(uint8_t * ptr, const char * str, int length, int startl, int endl, uint32_t fc, uint32_t bc, uint32_t line_delta)
{
    char end = 0;
    fc &= 0xf;
    bc &= 0xf;
    for (int i=0; i < length; ++i){
        if (0 == str[i]) end = ' ';
        _char_to_fb_4bit_pl(ptr + i * (CHAR_W/2), end ? end : str[i], startl, endl, fc, bc, line_delta);
    }
}

static inline void _put_str_col_extbuf(uint8_t * buffer, uint8_t x, uint8_t line, const char *str, const uint8_t * colstr, uint8_t length){
    char end = 0;
    for (int i=0; i < length; ++i){
        uint32_t fc = colstr[i] & 0xf;
        uint32_t bc = colstr[i] >> 4;
        if (0 == str[i]) end = ' ';
        _char_to_fb_4bit_pl(buffer + (x >> 1) + i * (CHAR_W/2), end ? end : str[i], line, line, fc, bc, 0);
    }
}

void put_str_col_extbuf(uint8_t * buffer, uint8_t x, uint8_t line, const char *str, const uint8_t * colstr, uint8_t length){
    _put_str_col_extbuf(buffer, x, line, str, colstr, length);
}

void print_str_col_extbuf(uint8_t * buffer, uint8_t x, uint8_t y, const char *str, const uint8_t * colstr, uint8_t length){
    for (int l = 0; l < CHAR_H; ++l){
        _put_str_col_extbuf(buffer, x, l, str, colstr, length);
        lcd_spi_xfer_line(&buffer[0], l+y, 4);
    }
}